/**
 * @cliArgs --device "MSPM0C110X" --part "Default" --package "VSSOP-20(DGS20)" --product "mspm0_sdk@2.09.00.02"
 * @versions {"tool":"1.25.0+4268"}
 */

/**
 * Import the modules used in this configuration.
 */
const GPIO   = scripting.addModule("/ti/driverlib/GPIO", {}, false);
const GPIO1  = GPIO.addInstance();
const GPIO2  = GPIO.addInstance();
const GPIO3  = GPIO.addInstance();
const SPI    = scripting.addModule("/ti/driverlib/SPI", {}, false);
const SPI1   = SPI.addInstance();
const SYSCTL = scripting.addModule("/ti/driverlib/SYSCTL");
const UART   = scripting.addModule("/ti/driverlib/UART", {}, false);
const UART1  = UART.addInstance();

/**
 * Write custom configuration values to the imported modules.
 */
GPIO1.$name                         = "DDS";
GPIO1.associatedPins.create(5);
GPIO1.associatedPins[0].$name       = "WCLK";
GPIO1.associatedPins[0].assignedPin = "23";
GPIO1.associatedPins[1].$name       = "D7";
GPIO1.associatedPins[1].assignedPin = "25";
GPIO1.associatedPins[2].$name       = "RST";
GPIO1.associatedPins[2].assignedPin = "17";
GPIO1.associatedPins[3].$name       = "FREQ_UPD";
GPIO1.associatedPins[3].assignedPin = "22";
GPIO1.associatedPins[4].$name       = "DDS_EN";
GPIO1.associatedPins[4].assignedPin = "2";

const Board = scripting.addModule("/ti/driverlib/Board", {}, false);

GPIO2.$name                         = "PA";
GPIO2.associatedPins[0].$name       = "EN";
GPIO2.associatedPins[0].assignedPin = "28";

GPIO3.$name                         = "GPIO_A";
GPIO3.associatedPins.create(3);
GPIO3.associatedPins[0].$name       = "RED_22";
GPIO3.associatedPins[0].assignedPin = "4";
GPIO3.associatedPins[1].$name       = "CS";
GPIO3.associatedPins[1].assignedPin = "24";
GPIO3.associatedPins[2].$name       = "DRDY";
GPIO3.associatedPins[2].assignedPin = "6";

SPI1.$name               = "SPI_0";
SPI1.targetBitRate       = 1000000;
SPI1.phase               = "1";
SPI1.frameFormat         = "MOTO3";
SPI1.sclkPinConfig.$name = "ti_driverlib_gpio_GPIOPinGeneric0";
SPI1.mosiPinConfig.$name = "ti_driverlib_gpio_GPIOPinGeneric1";
SPI1.misoPinConfig.$name = "ti_driverlib_gpio_GPIOPinGeneric2";

SYSCTL.clockTreeEn = true;

UART1.$name             = "UART_0";
UART1.targetBaudRate    = 1000000;
UART1.parity            = "ODD";
UART1.txPinConfig.$name = "ti_driverlib_gpio_GPIOPinGeneric3";
UART1.rxPinConfig.$name = "ti_driverlib_gpio_GPIOPinGeneric4";

/**
 * Pinmux solution for unlocked pins/peripherals. This ensures that minor changes to the automatic solver in a future
 * version of the tool will not impact the pinmux you originally saw.  These lines can be completely deleted in order to
 * re-solve from scratch.
 */
GPIO1.associatedPins[0].pin.$suggestSolution = "PA23";
GPIO1.associatedPins[1].pin.$suggestSolution = "PA25";
GPIO1.associatedPins[2].pin.$suggestSolution = "PA17";
GPIO1.associatedPins[3].pin.$suggestSolution = "PA22";
GPIO1.associatedPins[4].pin.$suggestSolution = "PA2";
Board.peripheral.$suggestSolution            = "DEBUGSS";
Board.peripheral.swclkPin.$suggestSolution   = "PA20";
Board.peripheral.swdioPin.$suggestSolution   = "PA19";
GPIO2.associatedPins[0].pin.$suggestSolution = "PA28";
GPIO3.associatedPins[0].pin.$suggestSolution = "PA4";
GPIO3.associatedPins[1].pin.$suggestSolution = "PA24";
GPIO3.associatedPins[2].pin.$suggestSolution = "PA6";
SPI1.peripheral.$suggestSolution             = "SPI0";
SPI1.peripheral.sclkPin.$suggestSolution     = "PA11";
SPI1.peripheral.mosiPin.$suggestSolution     = "PA18";
SPI1.peripheral.misoPin.$suggestSolution     = "PA16";
UART1.peripheral.$suggestSolution            = "UART0";
UART1.peripheral.rxPin.$suggestSolution      = "PA26";
UART1.peripheral.txPin.$suggestSolution      = "PA27";
